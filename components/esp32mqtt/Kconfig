## components/esp32mqtt/Kconfig
```kconfig
menu "esp32mqtt"

config ESP32_MQTT_COMP_FOO
    bool "foo / bar"
    default "y"
    help
        Some example config

endmenu
```

## components/iot/Kconfig
```kconfig
menu "iot"

config IOT_FOO
    bool "foo / bar"
    default "y"
    help
        Some example config
endmenu
```
